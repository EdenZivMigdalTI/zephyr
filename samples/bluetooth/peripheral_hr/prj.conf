## sample.yaml
```
sample:
  name: Bluetooth Peripheral HR
  description: Demonstrates the HR (Heart Rate) GATT Service
tests:
  sample.bluetooth.peripheral_hr:
    harness: bluetooth
    platform_allow:
      - qemu_cortex_m3
      - qemu_x86
      - nrf52_bsim
      - nrf5340bsim/nrf5340/cpuapp
      - nrf51dk/nrf51822
      - nrf52dk/nrf52832
      - nrf52840dk/nrf52840
      - nrf5340dk/nrf5340/cpuapp
      - nrf54l15dk/nrf54l15/cpuapp
      - ophelia4ev/nrf54l15/cpuapp
      - nrf54lm20dk/nrf54lm20a/cpuapp
      - lp_em_cc2340r53
      - lp_em_cc2745r10_q1/cc2745r10_q1
      - lp_em_cc2755p20
    integration_platforms:
      - qemu_cortex_m3
      - nrf52_bsim
      - nrf5340bsim/nrf5340/cpuapp
      - nrf51dk/nrf51822
      - nrf52dk/nrf52832
      - nrf52840dk/nrf52840
      - nrf5340dk/nrf5340/cpuapp
      - nrf54l15dk/nrf54l15/cpuapp
      - ophelia4ev/nrf54l15/cpuapp
      - nrf54lm20dk/nrf54lm20a/cpuapp
      - lp_em_cc2340r53
      - lp_em_cc2745r10_q1/cc2745r10_q1
      - lp_em_cc2755p20
    tags: bluetooth
    sysbuild: true
  sample.bluetooth.peripheral_hr.minimal:
    harness: bluetooth
    platform_allow:
      - qemu_cortex_m3
    integration_platforms:
      - qemu_cortex_m3
    extra_args:
      - CONF_FILE=prj_minimal.conf
    tags: bluetooth
  sample.bluetooth.peripheral_hr.bt_ll_sw_split.minimal:
    harness: bluetooth
    platform_allow:
      - bbc_microbit
      - nrf52dk/nrf52832
      - nrf54l15dk/nrf54l15/cpuapp
    integration_platforms:
      - bbc_microbit
      - nrf52dk/nrf52832
      - nrf54l15dk/nrf54l15/cpuapp
    extra_args:
      - CONF_FILE=prj_minimal.conf
      - EXTRA_CONF_FILE=overlay-bt_ll_sw_split-minimal.conf
    tags: bluetooth
  sample.bluetooth.peripheral_hr.bt_ll_sw_split.extended:
    harness: bluetooth
    platform_allow:
      - nrf52_bsim
      - nrf52dk/nrf52832
      - nrf52840dk/nrf52840
    integration_platforms:
      - nrf52_bsim
      - nrf52dk/nrf52832
      - nrf52840dk/nrf52840
    extra_args: EXTRA_CONF_FILE=overlay-extended.conf
    tags: bluetooth
  sample.bluetooth.peripheral_hr.multicore.bt_ll_sw_split.extended:
    harness: bluetooth
    platform_allow:
      - nrf5340bsim/nrf5340/cpuapp
      - nrf5340dk/nrf5340/cpuapp
    integration_platforms:
      - nrf5340bsim/nrf5340/cpuapp
      - nrf5340dk/nrf5340/cpuapp
    extra_args: CONFIG_BT_EXT_ADV=y
    tags: bluetooth
    sysbuild: true
  sample.bluetooth.peripheral_hr.bt_ll_sw_split.phy_coded:
    harness: bluetooth
    platform_allow:
      - nrf52_bsim
      - nrf52dk/nrf52832
      - nrf52840dk/nrf52840
    integration_platforms:
      - nrf52_bsim
      - nrf52dk/nrf52832
      - nrf52840dk/nrf52840
    extra_args: EXTRA_CONF_FILE=overlay-phy_coded.conf
    tags: bluetooth
    sysbuild: true
  sample.bluetooth.peripheral_hr.multicore.bt_ll_sw_split.phy_coded:
    harness: bluetooth
    platform_allow:
      - nrf5340bsim/nrf5340/cpuapp
      - nrf5340dk/nrf5340/cpuapp
    integration_platforms:
      - nrf5340bsim/nrf5340/cpuapp
      - nrf5340dk/nrf5340/cpuapp
    extra_args:
      - CONFIG_BT_EXT_ADV=y
    tags: bluetooth
    sysbuild: true
  sample.bluetooth.peripheral_hr_rv32m1_vega_openisa_rv32m1_ri5cy:
    platform_allow: rv32m1_vega/openisa_rv32m1/ri5cy
    tags: bluetooth
    build_only: true
  sample.bluetooth.peripheral_hr.frdm_kw41z_shield:
    harness: bluetooth
    depends_on: arduino_serial
    tags: bluetooth
    extra_args: SHIELD=frdm_kw41z
```

## prj.conf
```kconfig
CONFIG_BT=y
CONFIG_BT_PERIPHERAL=y
CONFIG_BT_DEVICE_NAME="Zephyr Heartrate Sensor"
CONFIG_PM=y
```

## src/main.c
```c
/* main.c - Application main entry point */

/*
 * Copyright (c) 2024 Nordic Semiconductor ASA
 * Copyright (c) 2015-2016 Intel Corporation
 *
 * SPDX-License-Identifier: Apache-2.0
 */

#include <zephyr/device.h>
#include <zephyr/devicetree.h>

#include <zephyr/bluetooth/bluetooth.h>
#include <zephyr/bluetooth/hci.h>
#include <zephyr/bluetooth/conn.h>
#include <zephyr/bluetooth/uuid.h>
#include <zephyr/bluetooth/gatt.h>
#if defined(CONFIG_BT_BAS)
#include <zephyr/bluetooth/services/bas.h>
#endif
#if defined(CONFIG_BT_HRS)
#include <zephyr/bluetooth/services/hrs.h>
#endif

#if defined(CONFIG_BT_HRS)
static bool hrf_ntf_enabled;
#endif

/* Wakes the main loop on connect/disconnect so it can sleep forever when
 * there are no periodic HRS/BAS updates to send.
 */
static K_SEM_DEFINE(state_sem, 0, 1);

static const struct bt_data ad[] = {
	BT_DATA_BYTES(BT_DATA_FLAGS, (BT_LE_AD_GENERAL | BT_LE_AD_NO_BREDR)),
#if defined(CONFIG_BT_HRS)
	BT_DATA_BYTES(BT_DATA_UUID16_ALL, BT_UUID_16_ENCODE(BT_UUID_HRS_VAL)),
#endif
#if defined(CONFIG_BT_BAS)
	BT_DATA_BYTES(BT_DATA_UUID16_ALL, BT_UUID_16_ENCODE(BT_UUID_BAS_VAL)),
#endif
#if defined(CONFIG_BT_DIS)
	BT_DATA_BYTES(BT_DATA_UUID16_ALL, BT_UUID_16_ENCODE(BT_UUID_DIS_VAL)),
#endif
#if defined(CONFIG_BT_EXT_ADV)
	BT_DATA(BT_DATA_NAME_COMPLETE, CONFIG_BT_DEVICE_NAME, sizeof(CONFIG_BT_DEVICE_NAME) - 1),
#endif /* CONFIG_BT_EXT_ADV */
};

#if !defined(CONFIG_BT_EXT_ADV)
static const struct bt_data sd[] = {
	BT_DATA(BT_DATA_NAME_COMPLETE, CONFIG_BT_DEVICE_NAME, sizeof(CONFIG_BT_DEVICE_NAME) - 1),
};
#endif /* !CONFIG_BT_EXT_ADV */

enum {
	STATE_CONNECTED,
	STATE_DISCONNECTED,

	STATE_BITS,
};

static ATOMIC_DEFINE(state, STATE_BITS);

static void connected(struct bt_conn *conn, uint8_t err)
{
	if (err) {
		printk("Connection failed, err 0x%02x %s\n", err, bt_hci_err_to_str(err));
	} else {
		printk("Connected\n");

		(void)atomic_set_bit(state, STATE_CONNECTED);
		k_sem_give(&state_sem);
	}
}

static void disconnected(struct bt_conn *conn, uint8_t reason)
{
	printk("Disconnected, reason 0x%02x %s\n", reason, bt_hci_err_to_str(reason));

	(void)atomic_set_bit(state, STATE_DISCONNECTED);
	k_sem_give(&state_sem);
}

BT_CONN_CB_DEFINE(conn_callbacks) = {
	.connected = connected,
	.disconnected = disconnected,
};

#if defined(CONFIG_BT_HRS)
static void hrs_ntf_changed(bool enabled)
{
	hrf_ntf_enabled = enabled;

	printk("HRS notification status changed: %s\n",
	       enabled ? "enabled" : "disabled");
}

static struct bt_hrs_cb hrs_cb = {
	.ntf_changed = hrs_ntf_changed,
};
#endif /* CONFIG_BT_HRS */

#if defined(CONFIG_BT_SMP)
static void auth_cancel(struct bt_conn *conn)
{
	char addr[BT_ADDR_LE_STR_LEN];

	bt_addr_le_to_str(bt_conn_get_dst(conn), addr, sizeof(addr));

	printk("Pairing cancelled: %s\n", addr);
}

static struct bt_conn_auth_cb auth_cb_display = {
	.cancel = auth_cancel,
};
#endif /* CONFIG_BT_SMP */

#if defined(CONFIG_BT_BAS)
static void bas_notify(void)
{
	uint8_t battery_level = bt_bas_get_battery_level();

	battery_level--;

	if (!battery_level) {
		battery_level = 100U;
	}

	bt_bas_set_battery_level(battery_level);
}
#endif /* CONFIG_BT_BAS */

#if defined(CONFIG_BT_HRS)
static void hrs_notify(void)
{
	static uint8_t heartrate = 90U;

	/* Heartrate measurements simulation */
	heartrate++;
	if (heartrate == 160U) {
		heartrate = 90U;
	}

	if (hrf_ntf_enabled) {
		bt_hrs_notify(heartrate);
	}
}
#endif /* CONFIG_BT_HRS */

#if defined(CONFIG_GPIO)
/* The devicetree node identifier for the "led0" alias. */
#define LED0_NODE DT_ALIAS(led0)

#if DT_NODE_HAS_STATUS_OKAY(LED0_NODE)
#include <zephyr/drivers/gpio.h>
#define HAS_LED     1
static const struct gpio_dt_spec led = GPIO_DT_SPEC_GET(LED0_NODE, gpios);
#define BLINK_ONOFF K_MSEC(500)

static struct k_work_delayable blink_work;
static bool                  led_is_on;

static void blink_timeout(struct k_work *work)
{
	led_is_on = !led_is_on;
	gpio_pin_set(led.port, led.pin, (int)led_is_on);

	k_work_schedule(&blink_work, BLINK_ONOFF);
}

static int blink_setup(void)
{
	int err;

	printk("Checking LED device...");
	if (!gpio_is_ready_dt(&led)) {
		printk("failed.\n");
		return -EIO;
	}
	printk("done.\n");

	printk("Configuring GPIO pin...");
	err = gpio_pin_configure_dt(&led, GPIO_OUTPUT_ACTIVE);
	if (err) {
		printk("failed.\n");
		return -EIO;
	}
	printk("done.\n");

	k_work_init_delayable(&blink_work, blink_timeout);

	return 0;
}

static void blink_start(void)
{
	printk("Start blinking LED...\n");
	led_is_on = false;
	gpio_pin_set(led.port, led.pin, (int)led_is_on);
	k_work_schedule(&blink_work, BLINK_ONOFF);
}

static void blink_stop(void)
{
	struct k_work_sync work_sync;

	printk("Stop blinking LED.\n");
	k_work_cancel_delayable_sync(&blink_work, &work_sync);

	/* Keep LED on */
	led_is_on = true;
	gpio_pin_set(led.port, led.pin, (int)led_is_on);
}
#endif /* LED0_NODE */
#endif /* CONFIG_GPIO */

int main(void)
{
	int err;

	err = bt_enable(NULL);
	if (err) {
		printk("Bluetooth init failed (err %d)\n", err);
		return 0;
	}

	printk("Bluetooth initialized\n");

#if defined(CONFIG_BT_SMP)
	bt_conn_auth_cb_register(&auth_cb_display);
#endif

#if defined(CONFIG_BT_HRS)
	bt_hrs_cb_register(&hrs_cb);
#endif

#if !defined(CONFIG_BT_EXT_ADV)
	printk("Starting Legacy Advertising (connectable and scannable)\n");
	err = bt_le_adv_start(BT_LE_ADV_CONN_FAST_1, ad, ARRAY_SIZE(ad), sd, ARRAY_SIZE(sd));
	if (err) {
		printk("Advertising failed to start (err %d)\n", err);
		return 0;
	}

#else /* CONFIG_BT_EXT_ADV */
	struct bt_le_adv_param adv_param = {
		.id = BT_ID_DEFAULT,
		.sid = 0U,
		.secondary_max_skip = 0U,
		.options = (BT_LE_ADV_OPT_EXT_ADV | BT_LE_ADV_OPT_CONN | BT_LE_ADV_OPT_CODED),
		.interval_min = BT_GAP_ADV_FAST_INT_MIN_2,
		.interval_max = BT_GAP_ADV_FAST_INT_MAX_2,
		.peer = NULL,
	};
	struct bt_le_ext_adv *adv;

	printk("Creating a Coded PHY connectable non-scannable advertising set\n");
	err = bt_le_ext_adv_create(&adv_param, NULL, &adv);
	if (err) {
		printk("Failed to create Coded PHY extended advertising set (err %d)\n", err);

		printk("Creating a non-Coded PHY connectable non-scannable advertising set\n");
		adv_param.options &= ~BT_LE_ADV_OPT_CODED;
		err = bt_le_ext_adv_create(&adv_param, NULL, &adv);
		if (err) {
			printk("Failed to create extended advertising set (err %d)\n", err);
			return 0;
		}
	}

	printk("Setting extended advertising data\n");
	err = bt_le_ext_adv_set_data(adv, ad, ARRAY_SIZE(ad), NULL, 0);
	if (err) {
		printk("Failed to set extended advertising data (err %d)\n", err);
		return 0;
	}

	printk("Starting Extended Advertising (connectable non-scannable)\n");
	err = bt_le_ext_adv_start(adv, BT_LE_EXT_ADV_START_DEFAULT);
	if (err) {
		printk("Failed to start extended advertising set (err %d)\n", err);
		return 0;
	}
#endif /* CONFIG_BT_EXT_ADV */

	printk("Advertising successfully started\n");

#if defined(HAS_LED)
	err = blink_setup();
	if (err) {
		return 0;
	}

	blink_start();
#endif /* HAS_LED */

	/* Implement notification. */
	while (1) {
#if defined(CONFIG_BT_HRS) || defined(CONFIG_BT_BAS)
		k_sleep(K_SECONDS(1));
#else
		/* Nothing periodic to do: sleep until a connect/disconnect event */
		k_sem_take(&state_sem, K_FOREVER);
#endif

#if defined(CONFIG_BT_HRS)
		/* Heartrate measurements simulation */
		hrs_notify();
#endif

#if defined(CONFIG_BT_BAS)
		/* Battery level simulation */
		bas_notify();
#endif

		if (atomic_test_and_clear_bit(state, STATE_CONNECTED)) {
			/* Connected callback executed */

#if defined(HAS_LED)
			blink_stop();
#endif /* HAS_LED */
		}

		/* Not "else if": the semaphore only holds one token, so a quick
		 * connect + disconnect must be handled in a single pass.
		 */
		if (atomic_test_and_clear_bit(state, STATE_DISCONNECTED)) {
#if !defined(CONFIG_BT_EXT_ADV)
			printk("Starting Legacy Advertising (connectable and scannable)\n");
			err = bt_le_adv_start(BT_LE_ADV_CONN_FAST_1, ad, ARRAY_SIZE(ad), sd,
					      ARRAY_SIZE(sd));
			if (err) {
				printk("Advertising failed to start (err %d)\n", err);
				return 0;
			}

#else /* CONFIG_BT_EXT_ADV */
			printk("Starting Extended Advertising (connectable and non-scannable)\n");
			err = bt_le_ext_adv_start(adv, BT_LE_EXT_ADV_START_DEFAULT);
			if (err) {
				printk("Failed to start extended advertising set (err %d)\n", err);
				return 0;
			}
#endif /* CONFIG_BT_EXT_ADV */

#if defined(HAS_LED)
			blink_start();
#endif /* HAS_LED */
		}
	}

	return 0;
}
```
